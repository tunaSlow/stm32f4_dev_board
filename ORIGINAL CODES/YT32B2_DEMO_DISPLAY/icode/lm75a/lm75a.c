/*
 * lcd.c
 *
 *  Created on: Oct 21, 2022
 *      Author: Administrator
 */

#include "lm75a.h"

//202301111842 修正了负温度补码没有处理小数部分的BUG

//读出LM75A的温度值（-55~125摄氏度）
//温度正负号（0正1负），温度整数，温度小数（点后2位）依次放入*Tempbuffer（十进制）
void LM75A_GetTemp(uint8_t *Tempbuffer){
	uint8_t buf[2]; //温度值储存
	uint8_t t=0,a=0;
    HAL_I2C_Mem_Read(&hi2c2,LM75A_ADD,TEMP,I2C_MEMADD_SIZE_8BIT,buf,2,1000); //读出温度值
	t = buf[0]; //处理温度整数部分，0~125度
	*Tempbuffer = 0; //温度值为正值
	if(t & 0x80){ //判断温度是否是负（MSB表示温度符号）
		*Tempbuffer = 1; //温度值为负值
		t = ~t; //计算补码（原码取反）
	}
	if(t & 0x01){ a=a+1; } //从高到低按位加入温度累加值（0~125）
	if(t & 0x02){ a=a+2; }
	if(t & 0x04){ a=a+4; }
	if(t & 0x08){ a=a+8; }
	if(t & 0x10){ a=a+16; }
	if(t & 0x20){ a=a+32; }
	if(t & 0x40){ a=a+64; }
	Tempbuffer++;//指针地址加1
	*Tempbuffer = a;//将小数值放入指针内容
	a = 0;
	t = buf[1]; //处理小数部分，取0.125精度的前2位（12、25、37、50、62、75、87）
	if(buf[0] & 0x80){ //判断温度是否是负（MSB表示温度符号）
		t = ~t; t+=0x20; //计算补码（原码取反后最后一个有效位加1）
		if((t&0xe0)==0x00) *Tempbuffer+=1;//当小数溢出时整数部分加1
	}
	if(t & 0x80){ a=a+50; } //0.50度精度累加
	if(t & 0x40){ a=a+25; } //0.25度精度累加（当温度传感器精度只有0.50度时可屏蔽本行）
	if(t & 0x20){ a=a+12; } //0.12度精度累加（当温度传感器精度只有0.50度时可屏蔽本行）
	Tempbuffer++;//指针地址加1
	*Tempbuffer = a;//将小数值放入指针内容
}

//LM75配置寄存器设置（参数：0x00正常工作模式，0x01关断模式，其他设置请参考数据手册）
void LM75_CONFIG(uint8_t cfg){
	HAL_I2C_Mem_Write(&hi2c2,LM75A_ADD,CONF,I2C_MEMADD_SIZE_8BIT,&cfg,1,1000); //写I2C2总线
}

/*********************************************************************************************
 * 洋桃电子 www.DoYoung.net
 * 部分程序代码复制自网络开源资料 如有侵权请联系我们处理
 * 洋桃电子原创程序代码部分均未声明版权 可自由复制使用 我们不对代码做任何担保
*********************************************************************************************/
